//说明：SI24R1 SPI 示例
//============!!!!!!!!!!!!!!!!!!!!!!!!!+===========
//CE、CSN、SCK、IRQ、MISO、MOSI需要定义为单片机的端口
//=====================================================================================
//函数：spi_init()
//功能: SPI引脚初始化     
//=====================================================================================
void spi_init(void)
{
	CE  = 0;        // 待机
	CSN = 1;        // SPI禁止
	SCK = 0;        // SPI时钟置低
	IRQ = 1;        // 中断复位
}
//=====================================================================================
//函数：spi_rw_byte()
//功能：根据SPI协议，写一字节数据到SI24R1，同时从SI24R1读出一字节
//=====================================================================================
uchar spi_rw_byte(uchar byte)
{
	uchar i;

   	for(i = 0; i < 8; i++)          // 循环8次
   	{
   		MOSI 	= (byte & 0x80);   	// byte最高位输出到MOSI
   		byte  <<= 1;             	// 低一位移位到最高位
   		SCK 	= 1;                // 拉高SCK，SI24R1从MOSI读入1位数据，同时从MISO输出1位数据
   		byte   |= MISO;       		// 读MISO到byte最低位
   		SCK 	= 0;            	// SCK置低
   	}
    return(byte);           		// 返回读出的一字节
}

//=====================================================================================
//函数：spi_rw_reg()
//功能：写数据value到reg寄存器，同时返回状态寄存器值
//=====================================================================================
uchar spi_rw_reg(uchar reg, uchar value)
{
	uchar status;

  	CSN 	= 0;                   	// CSN置低，开始传输数据
  	status = spi_rw_byte(reg);   	// 选择寄存器，同时返回状态字
  	spi_rw_byte(value);             // 然后写数据到该寄存器
  	CSN 	= 1;                   	// CSN拉高，结束数据传输
  	return(status);            		// 返回状态寄存器
}

//=====================================================================================
//函数：spi_rd_reg()
//功能：从reg寄存器读一个字节的数据
//=====================================================================================
//修改功能：return输出为对应地址的值 改为 {状态寄存器值+对应地址的值}

  
 uchar spi_rd_reg(uchar reg)
{
	uchar value;

  	CSN 	= 0;                	// CSN置低，开始传输数据
  	spi_rw_byte(reg);              	// 选择寄存器
  	value 	= spi_rw_byte(0);      	// 然后从该寄存器读数据 
  	CSN 	= 1;                	// CSN拉高，结束数据传输
  	return(value);            		// 返回寄存器数据
}

//=====================================================================================
//函数：spi_read_buf()
//功能：从reg寄存器读出bytes个字节，通常用来读取接收通道数据 或 接收/发送地址
//=====================================================================================
uchar spi_read_buf(uchar reg, uchar *pBuf, uchar bytes)
{

	uchar status;
	uchar i; 	

  	CSN 	= 0;                   	 // CSN置低，开始传输数据
  	status  = spi_rw_byte(reg);      // 选择寄存器，同时返回状态字

  	for(i = 0; i < bytes; i++)
    {
   		pBuf[i] = spi_rw_byte(0);    // 逐个字节从SI24R1+读出
	}
  	CSN 	= 1;                     // CSN拉高，结束数据传输
  	return(status);             	 // 返回状态寄存器
}

//=====================================================================================
//函数：spi_write_buf()
//功能：把pBuf缓存中的数据写入到SI24R1，通常用来写入发射通道数据 或 接收/发送地址
//=====================================================================================
uchar spi_write_buf(uchar reg, uchar *pBuf, uchar bytes)
{
	uchar status, i;
  	CSN 	= 0;                     // CSN置低，开始传输数据
  	status 	= spi_rw_byte(reg);      // 选择寄存器，同时返回状态字
  	for(i = 0; i < bytes; i++)
    {
   		spi_rw_byte(pBuf[i]);        // 逐个字节写入SI24R1+
	}
  	CSN 	= 1;                     // CSN拉高，结束数据传输
  	return(status);             	 // 返回状态寄存器
}



